#include <IRremote.h>
#if defined(ESP32)
int IR_RECEIVE_PIN = 15;
#else
int IR_RECEIVE_PIN = 11;
#endif
#include <SPI.h>
#include <Wire.h>
#include <Adafruit_GFX.h>
#include <Adafruit_SSD1306.h>
#define R 5
#define G 6
#define B 9
#define IR_PIN 11
#define POWER_BUTT 48
#define OPEN/CLOSE_BUTT 54
#define TV_POWER_BUTT 8
#define BUTT_1 59
#define BUTT_2 60
#define BUTT_3 61
#define BUTT_4 62
#define BUTT_5 63
#define BUTT_6 64
#define BUTT_7 65
#define BUTT_8 66
#define BUTT_9 67
#define CLEAR_BUTT 70
#define BUTT_0 68
#define AV_BUTT 11
#define CH+_BUTT 0
#define CH-_BUTT 1
#define VOL+_BUTT 2
#define VOL-_BUTT 3
#define SCAN<<_BUTT 50
#define SCAN>>_BUTT 51
#define SKIP<<_BUTT 53
#define SKIP>>_BUTT 52
#define PAUSE_BUTT 56
#define PLAY_BUTT 49
#define STOP_BUTT 57
#define DVD_MENU_BUTT 75
#define TITLE_BUTT 74
#define UP_BUTT1 71
#define LEFT_BUTT1 89
#define RIGHT_BUTT1 90
#define DOWN_BUTT1 72
#define ENTER_BUTT 88
#define DISPLAY_BUTT 58
#define RETURN_BUTT 69
#define AUDIO_BUTT 79
#define SUBTITLE_BUTT 80
#define ANGLE_BUTT 76
#define SETUP_BUTT 86
#define MARKER_BUTT 97
#define SEARCH_BUTT 98
#define PROGRAM_BUTT 87
#define ZOOM_BUTT 100
#define REPEAT_BUTT 83
#define A_B_BUTT 85
#define RANDOM_BUTT 81
#define STAR_BUTT 94
#define RESPONSE_TIME 10
#define ON 0
#define OFF 1
#define INCREASE_RATE 5 
#define SCREEN_WIDTH 128 
#define SCREEN_HEIGHT 64
#define OLED_RESET 4
Adafruit_SSD1306 display(SCREEN_WIDTH, SCREEN_HEIGHT, &Wire, OLED_RESET);

const unsigned char manhands [] PROGMEM = {
  0x00, 0x00, 0x00, 0x00, 0x00, 0x00, 0x00, 0x00, 0x00, 0x00, 0x00, 0x00, 0x00, 0x00, 0x00, 0x00, 
  0x00, 0x00, 0x00, 0x00, 0x00, 0x00, 0x00, 0x00, 0x00, 0x00, 0x00, 0x00, 0x00, 0x00, 0x00, 0x00, 
  0x00, 0x00, 0x00, 0x00, 0x00, 0x00, 0x00, 0x00, 0x00, 0x00, 0x00, 0x00, 0x00, 0x00, 0x00, 0x00, 
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  0x00, 0x00, 0x00, 0x00, 0x0f, 0x80, 0x00, 0x0e, 0x00, 0x00, 0x00, 0x00, 0x00, 0x00, 0x00, 0x00
};
const unsigned char land [] PROGMEM = {
  0x00, 0x00, 0x00, 0x00, 0x00, 0x00, 0x00, 0x00, 0x00, 0x00, 0x00, 0x00, 0x00, 0x00, 0x00, 0x00, 
  0x00, 0x00, 0x00, 0x00, 0x00, 0x00, 0x00, 0x00, 0x00, 0x00, 0x00, 0x00, 0x00, 0x00, 0x00, 0x00, 
  0x00, 0x00, 0x00, 0x00, 0x00, 0x00, 0x00, 0x00, 0x00, 0x00, 0x00, 0x00, 0x00, 0x00, 0x00, 0x00, 
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  0x00, 0x00, 0x00, 0x00, 0x00, 0x00, 0x00, 0x00, 0x02, 0xaa, 0xaa, 0xaa, 0x80, 0x00, 0x00, 0x00
};

int xc=250;
int siz=500;
int siz1=64;
String dir;
void setup() {
Serial.begin(115200);
IrReceiver.begin(IR_RECEIVE_PIN, ENABLE_LED_FEEDBACK); 
 display.begin(SSD1306_SWITCHCAPVCC, 0x3D);
display.clearDisplay();
delay(1);
display.setCursor(0,0);
display.setTextColor(WHITE);
display.setTextSize(2);
display.println("ESP CRAFT");
display.display();
delay(100);
display.clearDisplay();
}

void loop() {
Serial.println(xc);  
display.drawBitmap(xc, 0, land, siz, siz1, 1);
display.drawBitmap(0, 0, manhands, 128, 64, 1);
display.setCursor(0,0);
display.setTextColor(WHITE);
display.setTextSize(1);
display.println(dir);
display.display();
delay(1);
display.clearDisplay();
ircontrol();
properties();
}

void ircontrol(){
if (IrReceiver.decode()) {
   if(IrReceiver.decodedIRData.command == RIGHT_BUTT1 ){
xc=xc-10; 
  }  
     if(IrReceiver.decodedIRData.command == LEFT_BUTT1 ){
xc=xc+10;
   
  } 
       if(IrReceiver.decodedIRData.command== DOWN_BUTT1 ){

siz1=siz1+1;  
  }
         if(IrReceiver.decodedIRData.command== UP_BUTT1){

siz1=siz1-1;  
  }
}   
    IrReceiver.resume();                             
   delay(100);  
  }

void properties(){
if(xc<=0 && xc>-250){
dir="W";  
  }
if(xc<=-250){
dir="E";  
  }if(xc>0){
xc=0;  
  }  
if(xc<-370){
xc=-370;  
  } 
 
}
  
